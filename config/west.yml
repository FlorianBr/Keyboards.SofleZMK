## config/west.yml
```yaml
manifest:
  remotes:
    - name: zmkfirmware
      url-base: https://github.com/zmkfirmware
    - name: urob
      url-base: https://github.com/urob
    # - name: m165437
    #   url-base: https://github.com/M165437
    - name: prospector
      url-base: https://github.com/t-ogura
    - name: siddhantac
      url-base: https://github.com/siddhantac 

  projects:
    # ZMK Base Firmware
    - name: zmk
      remote: zmkfirmware
      revision: main
      import: app/west.yml
    # ZMK-Helpers: For german unicode chars
    - name: zmk-helpers
      remote: urob
      revision: main
    # nice!view gem
    # - name: nice-view-gem
    #   remote: m165437
    #   revision: main
    # Prospector Dongle
    - name: prospector-zmk-module
      remote: prospector
      revision: v1.1.1
      path: modules/prospector-zmk-module
    # Araska Anim on right display
    - name: nice-view
      remote: siddhantac 
      revision: main 

  self:
    path: config
```
